## conf/layer.conf
```bitbake
# We have a conf and classes directory, add to BBPATH
BBPATH .= ":${LAYERDIR}"

# We have recipes-* directories, add to BBFILES
BBFILES += "${LAYERDIR}/recipes-*/*/*.bb \
	${LAYERDIR}/recipes-*/*/*.bbappend"

BBFILE_COLLECTIONS += "meta-infobeamer"
BBFILE_PATTERN_meta-infobeamer = "^${LAYERDIR}/"
BBFILE_PRIORITY_meta-infobeamer = "10"

# Libraries needed by infobeamer
IMAGE_INSTALL_append = " libevent libpng ffmpeg freetype userland"

# Allow installing ffmpeg
LICENSE_FLAGS_WHITELIST += " commercial"

# Memory split 256 / 768. Assumes RPi with 1024M memory
GPU_MEM_1024 = "256"
```
